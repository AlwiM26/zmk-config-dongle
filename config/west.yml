## config/west.yml
```yaml
manifest:
  remotes:
    - name: zmkfirmware
      url-base: https://github.com/zmkfirmware
    # dongle_display
    - name: AlwiM26
      url-base: https://github.com/AlwiM26
    - name: englmaxi
      url-base: https://github.com/englmaxi
  projects:
    - name: zmk
      remote: zmkfirmware
      revision: main
      import: app/west.yml
    # dongle_display
    - name: zmk-dongle-display
      remote: AlwiM26
      revision: main
  self:
    path: config
```
